## Kconfig
```kconfig
config KLOR_RGB_REACTIVE
    bool "KLOR per-key reactive underglow"
    depends on LED_STRIP
    help
      White underglow where the LED under a pressed key brightens and returns
      to idle on release.

      Takes exclusive ownership of the led_strip device, so ZMK_RGB_UNDERGLOW
      must be n while this is enabled -- two writers on one strip would fight.
      That also means ZMK's &rgb_ug behaviors do nothing, which is why the SYS
      layer no longer carries any. The replacement is &rgb, defined in
      boards/shields/klor/klor_common.dtsi and implemented by
      src/klor_rgb_behavior.c, which switches this module on and off and
      persists the choice.

if KLOR_RGB_REACTIVE

config KLOR_RGB_REACTIVE_IDLE_BRT
    int "Idle brightness, percent"
    range 0 100
    default 10

config KLOR_RGB_REACTIVE_PRESS_BRT
    int "Pressed-key brightness, percent"
    range 0 100
    default 60
    help
      Keep this modest. White drives all three dies on every LED, and on this
      board the supply sags above roughly 70% - green and blue starve before
      red, so white drifts pink. Only a few LEDs are lit at once here, so the
      load is far lower than a full-strip white, but the ceiling is real.

endif # KLOR_RGB_REACTIVE

config KLOR_STATUS_SCREEN
    bool "KLOR keymap status screen"
    depends on ZMK_DISPLAY_STATUS_SCREEN_CUSTOM
    select LV_USE_LABEL
    select LV_FONT_UNSCII_8
    select LV_USE_CANVAS
    select LV_USE_IMAGE
    help
      Draws a miniature map of the active layer on the OLED instead of ZMK's
      status widgets, with the key being pressed shown inverted. There is no
      room for both a keymap and status icons on 128x64 at 1bpp.

      The screen is drawn into an LV_COLOR_FORMAT_I1 canvas, because a label
      cannot style one character differently from its neighbours and inverting a
      single cell is the whole point. LV_USE_CANVAS is selected rather than
      implied: lvgl only defaults it on when LV_CONF_MINIMAL is off, and it is
      the widget the screen cannot work without. LV_USE_IMAGE goes with it --
      lvgl merely "imply"s it from LV_USE_CANVAS, and an imply can be overridden
      to n, which would fail to link rather than warn.

      Runs on both halves; each draws its own six columns of the grid and
      highlights its own keys, since zmk_position_state_changed is raised
      locally by each board's matrix scan.

      The active layer is central-only, and that is a link-time constraint
      rather than a policy: ZMK compiles neither src/keymap.c nor
      src/events/layer_state_changed.c into a non-central build, so the
      peripheral cannot call zmk_keymap_highest_layer_active() or subscribe to
      the layer event at all. It draws BASE until the layer is carried across
      the split link.

      Needs src/keymap_glyphs.h, generated by scripts/gen_keymap_glyphs.py.
      Regenerate after any keymap change or the display will misreport the keys.
```
